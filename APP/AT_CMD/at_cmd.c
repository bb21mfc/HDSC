/*****************************************************************************
*Copyright(C) 2017,GosuncnWelink
*
*  Module Name ：UART驱动
*  File Name   ：bsp_uart.c
*  Description ：提供UART相关驱动
*  Author      ：maheng
*  Version     ：
*  Data        ：2020-05-26
*  Others      ：
*  Revision Details1：
*  Modify Data：
*  Version：
*  Author：
*  Modification：
*  Revision Details2：
*****************************************************************************/

/***************************************************************************
* Include Files                       文件引用
***************************************************************************/
#include "at_cmd.h"

/***************************************************************************
* Manifest Constants                    常量
***************************************************************************/

/***************************************************************************
* Macros                               宏定义
***************************************************************************/

/***************************************************************************
* Types                               类型定义
***************************************************************************/

/***************************************************************************
* Variables Declare                 外部变量声明
***************************************************************************/

/***************************************************************************
* Function Declare                  外部函数声明
***************************************************************************/

/***************************************************************************
* Variables                           全局变量
***************************************************************************/
TaskHandle_t AT_ProcessHandle;

app_fifo_t Uart_Fifo;

/***************************************************************************
* Static Variables                   本地全局变量
***************************************************************************/
static uint8_t Uart_Fifo_Buffer[1024] = {0};

/*****************************************************************************
*	函数名		： UartProcess
*	功能	    ： AT命令解析流程
*	输入参数	： NULL
*	输出参数	： NULL
*	返回值说明  ： NULL
*	其他说明	： AT命令解析流程
*****************************************************************************/
void AT_Process( void * pvParameters )
{
	uint32_t Fifo_Len = 0;
	uint8_t Uart_RX_Buffer[128] = {0};
	
	app_fifo_init(&Uart_Fifo,Uart_Fifo_Buffer,1024);
	
	while(1)
	{
		//LOGAT("AT_Process is running\r\n");
		
		Fifo_Len = fifo_length(&Uart_Fifo);
		if(Fifo_Len != 0)
		{
			vTaskDelay(10);
			Fifo_Len = fifo_length(&Uart_Fifo);	//等待接收完成
			app_fifo_read(&Uart_Fifo,Uart_RX_Buffer,Fifo_Len);
			USART3_SendData(Uart_RX_Buffer,Fifo_Len);
		}
		
		vTaskDelay(50);
	}
}
/*****************************************************************************
*	函数名		： Task_AT_Process_Start
*	功能	    ： 创建AT解析任务
*	输入参数	： NULL
*	输出参数	： NULL
*	返回值说明  ： NULL
*	其他说明	： NULL
*****************************************************************************/
void Task_AT_Process_Start(void)
{
	BaseType_t xReturn;
	
	xReturn = xTaskCreate( AT_Process, "AT_Process", 2048, NULL, 8, &AT_ProcessHandle);
	
	if(xReturn != pdPASS)
	{
		Write_Uart_Debug("Creat AT_Process Fail\r\n");
	}
}

